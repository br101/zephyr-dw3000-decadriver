/*
 * Copyright (c) 2021 Callender-Consulting, LLC
 *
 * SPDX-License-Identifier: Apache-2.0
 */

&arduino_spi {
    status = "okay";
    cs-gpios = <&arduino_header 16 GPIO_ACTIVE_LOW>; /* D10 */

    dws3000@0 {
        compatible = "decawave,dw3000";
        label = "DWS3000";
        spi-max-frequency = <1000000>;
        reg = <0>;
        wakeup-gpios  = <&arduino_header 15 GPIO_ACTIVE_HIGH>; /* D9 */
        irq-gpios     = <&arduino_header 14 GPIO_ACTIVE_HIGH>; /* D8 */
        reset-gpios   = <&arduino_header 13 GPIO_ACTIVE_LOW>; /* D7 */
        spi-pol-gpios = <&arduino_header  7 GPIO_ACTIVE_LOW>; /* D1 */
        spi-pha-gpios = <&arduino_header  6 GPIO_ACTIVE_LOW>; /* D0 */
    };
};
