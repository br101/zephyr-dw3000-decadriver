## Kconfig
```kconfig
menuconfig DW3000
	bool "DW3000 Driver"
	depends on SPI
	help
		Qorvo/Decawave DW3000 driver

	choice
		prompt "Select  Chip"
		depends on DW3000

		config DW3000_CHIP_DW3000
			bool "DW3000"
		config DW3000_CHIP_DW3720
			bool "DW3720/QM33xx"
	endchoice

module = DW3000
module-str = dw3000
source "subsys/logging/Kconfig.template.log_config"
```

## boards/arm/qorvo/decawave_dwm3001cdk/Kconfig.board
```kconfig
# Qorvo DWM3001 board configuration

# Copyright (c) 2022 Sven Hoyer
# SPDX-License-Identifier: Apache-2.0

config BOARD_QORVO_DWM3001CDK
	bool "Qorvo DWM3001CDK"
	depends on SOC_NRF52833_QIAA
```

## boards/shields/qorvo_dws3000/Kconfig.defconfig
```kconfig
# Copyright (c) 2021 Callender-Consulting, LLC
# SPDX-License-Identifier: Apache-2.0

if SHIELD_QORVO_DWS3000

config SPI
	default y

config GPIO
	default y

config DW3000
	default y

endif # SHIELD_SHIELD_QORVO_DWS3000
```

## zephyr/Kconfig
```kconfig
menuconfig DW3000
	bool "DW3000"
	depends on SPI
	help
		Qorvo/Decawave DW3000 driver

module = DW3000
module-str = dw3000
source "subsys/logging/Kconfig.template.log_config"
```

## zephyr/boards/shields/qorvo_dws3000/Kconfig.shield
```kconfig
# Copyright (c) 2021 Callender-Consulting, LLC
# SPDX-License-Identifier: Apache-2.0

config SHIELD_QORVO_DWS3000
	def_bool $(shields_list_contains,qorvo_dws3000)
```

## zephyr/dts/bindings/decawave,dw3000/decawave,dw3000.yaml
```yaml
# Copyright (c) 2022, Bruno Randolf <br1@einfach.org>
#
# SPDX-License-Identifier: Apache-2.0

description: Qorvo/Decawave DW3000 (SPI)

compatible: "decawave,dw3000"

include: spi-device.yaml

properties:
    reset-gpios:
      type: phandle-array
      required: true
      description: RESET pin (active low)

    irq-gpios:
      type: phandle-array
      required: true
      description: IRQ pin (active high)

    wakeup-gpios:
      type: phandle-array
      required: false
      description: WAKEUP pin (active high)

    spi-pol-gpios:
      type: phandle-array
      required: false
      description: SPI Polarity pin

    spi-pha-gpios:
      type: phandle-array
      required: false
      description: SPI Phase pin
```
